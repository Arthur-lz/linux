## driver/chardev/Kconfig
```kconfig
menu "HELLO_CDEV_DRV"
	config CDEV_TEST_LZ
		bool "cdev_test"
		default n
	help
	if you unselected it, you will do nothing.
endmenu
```

## driver/hello/Kconfig
```kconfig
menu "hello_lz"
	config HELLO_KERNEL
		bool "hello_kernel"
		default n
	help
	if you unselect it, you can do nothing.
endmenu
```
